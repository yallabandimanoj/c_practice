## yocto/meta-Makefile/conf/layer.conf
```bitbake
# We have a conf and classes directory, add to BBPATH
BBPATH .= ":${LAYERDIR}"

# We have recipes-* directories, add to BBFILES
BBFILES += "${LAYERDIR}/recipes-*/*/*.bb \
            ${LAYERDIR}/recipes-*/*/*.bbappend"

BBFILE_COLLECTIONS += "meta-Makefile"
BBFILE_PATTERN_meta-Makefile = "^${LAYERDIR}/"
BBFILE_PRIORITY_meta-Makefile = "6"

LAYERDEPENDS_meta-Makefile = "core"
LAYERSERIES_COMPAT_meta-Makefile = "gatesgarth"
```

## yocto/meta-autoconf/conf/layer.conf
```bitbake
# We have a conf and classes directory, add to BBPATH
BBPATH .= ":${LAYERDIR}"

# We have recipes-* directories, add to BBFILES
BBFILES += "${LAYERDIR}/recipes-*/*/*.bb \
            ${LAYERDIR}/recipes-*/*/*.bbappend"

BBFILE_COLLECTIONS += "meta-autoconf"
BBFILE_PATTERN_meta-autoconf = "^${LAYERDIR}/"
BBFILE_PRIORITY_meta-autoconf = "6"

LAYERDEPENDS_meta-autoconf = "core"
LAYERSERIES_COMPAT_meta-autoconf = "gatesgarth"
```

## yocto/meta-cmake/conf/layer.conf
```bitbake
# We have a conf and classes directory, add to BBPATH
BBPATH .= ":${LAYERDIR}"

# We have recipes-* directories, add to BBFILES
BBFILES += "${LAYERDIR}/recipes-*/*/*.bb \
            ${LAYERDIR}/recipes-*/*/*.bbappend"

BBFILE_COLLECTIONS += "meta-cmake"
BBFILE_PATTERN_meta-cmake = "^${LAYERDIR}/"
BBFILE_PRIORITY_meta-cmake = "6"

LAYERDEPENDS_meta-cmake = "core"
LAYERSERIES_COMPAT_meta-cmake = "gatesgarth"
```

## yocto/meta-manoj/conf/layer.conf
```bitbake
# We have a conf and classes directory, add to BBPATH
BBPATH .= ":${LAYERDIR}"

# We have recipes-* directories, add to BBFILES
BBFILES += "${LAYERDIR}/recipes-*/*/*.bb \
            ${LAYERDIR}/recipes-*/*/*.bbappend"

BBFILE_COLLECTIONS += "meta-manoj"
BBFILE_PATTERN_meta-manoj = "^${LAYERDIR}/"
BBFILE_PRIORITY_meta-manoj = "6"

LAYERDEPENDS_meta-manoj = "core"
LAYERSERIES_COMPAT_meta-manoj = "gatesgarth"
```
